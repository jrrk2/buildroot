## package/bison/Config.in
```kconfig
config BR2_PACKAGE_BISON
	bool "bison"
	select BR2_PACKAGE_M4
	help
	  GNU bison parser generator.

	  http://www.gnu.org/software/bison/
```

## package/gcc8-native/Config.in
```kconfig
config BR2_PACKAGE_GCC8_NATIVE
	bool "gcc8-native"
	depends on BR2_TOOLCHAIN_USES_MUSL
	help
	  GCC 8.4.0 cross-compiled to run natively on the target.
	  Provides a C compiler (cc1, cpp, gcc driver) for on-device
	  compilation. C only, no multilib, minimal runtime libraries.
	  Approximately 10-15MB installed.
```

## package/m4/Config.in
```kconfig
config BR2_PACKAGE_M4
	bool "m4"
	help
	  GNU m4 macro processor.

	  http://www.gnu.org/software/m4/
```
